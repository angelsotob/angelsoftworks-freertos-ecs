## sdkconfig.defaults
```kconfig
# === Partition Table ===
CONFIG_PARTITION_TABLE_CUSTOM=y
CONFIG_PARTITION_TABLE_CUSTOM_FILENAME="partitions_table/partitions_table.csv"
CONFIG_PARTITION_TABLE_OFFSET=0x8000

# Asegura que no queden activos otros presets
CONFIG_PARTITION_TABLE_SINGLE_APP=n
CONFIG_PARTITION_TABLE_SINGLE_APP_LARGE=n
CONFIG_PARTITION_TABLE_TWO_OTA=n
CONFIG_PARTITION_TABLE_TWO_OTA_LARGE=n
```
